## main/Kconfig.projbuild
```kconfig
menu "SmartLamp Configuration"

    menu "Wi-Fi Settings"
        config SMARTLAMP_WIFI_SSID
            string "Wi-Fi SSID"
            default ""
            help
                Wi-Fi network name (SSID). Used for SNTP time sync
                and OTA firmware download.

        config SMARTLAMP_WIFI_PASSWORD
            string "Wi-Fi Password"
            default ""
            help
                Wi-Fi password.
    endmenu

    menu "OTA Settings"
        config SMARTLAMP_OTA_ENABLE
            bool "Enable OTA firmware upgrade"
            default y
            help
                Enable Over-The-Air firmware upgrade on boot.
                ESP32 will check for new firmware from configured
                URL after WiFi connects, download and flash if newer.

        config APP_PROJECT_VER
            string "Firmware version string"
            default "1.0.2"
            help
                Application version string used for OTA version comparison.
                Compared against the server version.txt content to decide
                whether to download a new firmware.

        config SMARTLAMP_OTA_FIRMWARE_URL
            string "OTA Firmware URL"
            default ""
            help
                HTTP URL to download the firmware .bin file, e.g.:
                http://192.168.1.100:8070/smartlamp.bin
                Uses HTTP (no TLS), must enable CONFIG_ESP_HTTPS_OTA_ALLOW_HTTP
                in sdkconfig.defaults.

        config SMARTLAMP_OTA_VERSION_URL
            string "OTA Version Check URL"
            default ""
            help
                HTTP URL to check latest firmware version, e.g.:
                http://192.168.1.100:8070/version.txt
                The file should contain a version string like "1.0.1".
                If empty, OTA will download unconditionally (not recommended).
    endmenu

    menu "Power Management"
        config SMARTLAMP_PM_ENABLE
            bool "Enable auto light sleep"
            default y
            help
                Automatically enter light sleep (~0.8mA) after idle timeout.
                Wake up on button press (GPIO13/14, must be wired to 3.3V).

                NOTE: During light sleep, BLE advertising stops and the
                device is not discoverable. Press a button to wake and
                reconnect.

        config SMARTLAMP_PM_IDLE_TIMEOUT_SEC
            int "Idle timeout before sleep (seconds)"
            default 300
            range 30 3600
            depends on SMARTLAMP_PM_ENABLE
            help
                Enter light sleep after this many seconds with no user
                interaction (no BLE connection, no button/voice commands,
                no alarm running, no person detected by radar).
    endmenu

endmenu
```

## sdkconfig.defaults
```kconfig
# GlowMate SmartLamp - ESP32 SDK Config Defaults
# ESP32-WROOM-32, ESP-IDF v5.x

# CPU & Flash
CONFIG_ESPTOOLPY_FLASHMODE_QIO=y
CONFIG_ESPTOOLPY_FLASHSIZE_4MB=y
CONFIG_ESPTOOLPY_FLASHSIZE="4MB"

# FreeRTOS
CONFIG_FREERTOS_HZ=100
CONFIG_ESP_MAIN_TASK_STACK_SIZE=4096

# WiFi
CONFIG_ESP32_WIFI_STATIC_RX_BUFFER_NUM=8
CONFIG_ESP32_WIFI_DYNAMIC_RX_BUFFER_NUM=32

# BLE (NimBLE, 内置 bt 组件)
CONFIG_BT_ENABLED=y
CONFIG_BTDM_CTRL_MODE_BLE_ONLY=y
CONFIG_BTDM_CTRL_MODE_BR_EDR_ONLY=n
CONFIG_BTDM_CTRL_MODE_BTDM=n
CONFIG_BT_BLUEDROID_ENABLED=n
CONFIG_BT_NIMBLE_ENABLED=y
CONFIG_BT_NIMBLE_ROLE_PERIPHERAL=y
CONFIG_BT_NIMBLE_MAX_CONNECTIONS=1
CONFIG_BT_NIMBLE_NVS_PERSIST=y

# LWIP (TCP sockets)
CONFIG_LWIP_MAX_SOCKETS=8

# Partition table
CONFIG_PARTITION_TABLE_CUSTOM=y
CONFIG_PARTITION_TABLE_CUSTOM_FILENAME="partitions.csv"

# Compiler
CONFIG_COMPILER_OPTIMIZATION_SIZE=y

# Log level (reduce overhead)
CONFIG_LOG_DEFAULT_LEVEL_INFO=y
CONFIG_LOG_MAXIMUM_LEVEL_INFO=y

# ====== OTA Firmware Upgrade ======
# Allow HTTP (no TLS certificate required, development convenience)
CONFIG_ESP_HTTPS_OTA_ALLOW_HTTP=y
# App version embedded in firmware header — compared against server
CONFIG_APP_PROJECT_VER="1.0.2"
# Bootloader rollback support: if new OTA firmware fails to boot, roll back
CONFIG_BOOTLOADER_APP_ROLLBACK_ENABLE=y
# HTTP client (used by OTA to download firmware)
CONFIG_ESP_HTTP_CLIENT_ENABLE_HTTPS=n

# ====== LVGL 9 (0.96" OLED 128x64) ======
CONFIG_LV_FONT_MONTSERRAT_10=n
CONFIG_LV_FONT_MONTSERRAT_12=y
CONFIG_LV_FONT_MONTSERRAT_14=y
CONFIG_LV_FONT_MONTSERRAT_24=y
CONFIG_LV_FONT_MONTSERRAT_28=n
CONFIG_LV_MEM_SIZE_KILOBYTES=32
CONFIG_LV_USE_ANIMIMG=n
CONFIG_LV_USE_ARC=n
CONFIG_LV_USE_ARCLABEL=n
CONFIG_LV_USE_BAR=n
CONFIG_LV_USE_BUTTON=n
CONFIG_LV_USE_BUTTONMATRIX=n
CONFIG_LV_USE_CALENDAR=n
CONFIG_LV_USE_CALENDAR_HEADER_ARROW=n
CONFIG_LV_USE_CALENDAR_HEADER_DROPDOWN=n
CONFIG_LV_USE_CANVAS=n
CONFIG_LV_USE_CHART=n
CONFIG_LV_USE_CHECKBOX=n
CONFIG_LV_USE_DROPDOWN=n
CONFIG_LV_USE_FLEX=n
CONFIG_LV_USE_GRID=n
CONFIG_LV_USE_IMAGEBUTTON=n
CONFIG_LV_USE_IMAGE=y
CONFIG_LV_USE_KEYBOARD=n
CONFIG_LV_USE_LED=n
CONFIG_LV_USE_LINE=n
CONFIG_LV_USE_LIST=n
CONFIG_LV_USE_MENU=n
CONFIG_LV_USE_MSGBOX=n
CONFIG_LV_USE_OBSERVER=n
CONFIG_LV_USE_ROLLER=n
CONFIG_LV_USE_SCALE=n
CONFIG_LV_USE_SLIDER=n
CONFIG_LV_USE_SPAN=n
CONFIG_LV_USE_SPINBOX=n
CONFIG_LV_USE_SPINNER=n
CONFIG_LV_USE_SWITCH=n
CONFIG_LV_USE_TABLE=n
CONFIG_LV_USE_TABVIEW=n
CONFIG_LV_USE_TEXTAREA=n
CONFIG_LV_USE_THEME_SIMPLE=n
CONFIG_LV_USE_TILEVIEW=n
CONFIG_LV_USE_WIN=n
CONFIG_LV_DRAW_SW_COMPLEX=n
CONFIG_LV_DRAW_SW_SUPPORT_A8=n
CONFIG_LV_DRAW_SW_SUPPORT_AL88=n
CONFIG_LV_DRAW_SW_SUPPORT_ARGB8888=n
CONFIG_LV_DRAW_SW_SUPPORT_ARGB8888_PREMULTIPLIED=n
CONFIG_LV_DRAW_SW_SUPPORT_L8=n
CONFIG_LV_DRAW_SW_SUPPORT_RGB565A8=n
CONFIG_LV_DRAW_SW_SUPPORT_RGB888=n
CONFIG_LV_DRAW_SW_SUPPORT_XRGB8888=n
CONFIG_LV_DRAW_SW_I1_LUM_THRESHOLD=95
CONFIG_LV_BUILD_EXAMPLES=n
CONFIG_LV_BUILD_DEMOS=n

CONFIG_LV_USE_THEME_DEFAULT=n
CONFIG_LV_THEME_DEFAULT_GROW=n
CONFIG_LV_USE_ASSERT_MALLOC=n
CONFIG_LV_USE_ASSERT_NULL=n
CONFIG_LV_LABEL_TEXT_SELECTION=n
CONFIG_LV_LABEL_LONG_TXT_HINT=n
CONFIG_LV_USE_FONT_PLACEHOLDER=n
```
